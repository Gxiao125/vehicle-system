VERSION ""

NS_ :

BS_:

BU_: BODY_ECU DIAG_TOOL

BO_ 0x710 DiagnosticRequest: 8 DIAG_TOOL
 SG_ SessionType : 0|8@1+ (1,0) [0|255] "" BODY_ECU
 SG_ Data : 8|56@1+ (1,0) [0|0] "" BODY_ECU

BO_ 0x711 DiagnosticResponse: 8 BODY_ECU
 SG_ ResponseCode : 0|8@1+ (1,0) [0|255] "" DIAG_TOOL
 SG_ Data : 8|56@1+ (1,0) [0|0] "" DIAG_TOOL

BO_ 0x712 DiagnosticData: 8 BODY_ECU
 SG_ BlockCounter : 0|8@1+ (1,0) [0|255] "" DIAG_TOOL
 SG_ Data : 8|56@1+ (1,0) [0|0] "" DIAG_TOOL
